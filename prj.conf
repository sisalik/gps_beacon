## CMakeLists.txt
```
cmake_minimum_required(VERSION 3.20.0)
find_package(Zephyr REQUIRED HINTS $ENV{ZEPHYR_BASE})
project(gps_beacon)

target_sources(app PRIVATE src/main.c src/bluetooth.c src/serial.c src/utils.c)
```

## prj.conf
```kconfig
CONFIG_SERIAL=y
CONFIG_UART_INTERRUPT_DRIVEN=y
CONFIG_PRINTK=y
CONFIG_LOG_BACKEND_UART=n

CONFIG_BT=y
CONFIG_BT_DEBUG_LOG=y
```

## src/main.c
```c
/**
 * @file main.c
 * @author Siim Lepik (siim.lepik@gmail.com)
 * @brief Application main entry point
 * @version 0.1
 * @date 2023-01-31
 *
 * @copyright Copyright (c) 2023
 *
 */

#include <math.h>
#include <stdlib.h>
#include <string.h>
#include <zephyr/kernel.h>
#include <zephyr/logging/log.h>
#include <zephyr/sys/printk.h>
#include <zephyr/sys/util.h>
#include <zephyr/types.h>

#include "bluetooth.h"
#include "serial.h"
#include "utils.h"

LOG_MODULE_REGISTER(main);

/**
 * @brief Parse a command from the serial interface
 *
 * @param cmd Command string
 *
 * @retval 0 Command parsed successfully
 * @retval ERROR_MISSING_ARGUMENTS Command is missing arguments
 * @retval ERROR_INVALID_ARGUMENTS Command has invalid arguments
 * @retval ERROR_UNRECOGNISED_CMD Command is unrecognised
 */
int parse_cmd(char *cmd) {
    int err = 0;
    char *token;
    char *saveptr;

    // Split the command by spaces
    token = strtok_r(cmd, CMD_SEPARATOR, &saveptr);

    if (strcmp(token, "help") == 0) {
        printk("Available commands:\r\n");
        printk("  ad-start - Start advertising\r\n");
        printk("  ad-stop - Stop advertising\r\n");
        printk("  help - Print this help message\r\n");
        printk(
            "  pos-set lat lon alt - Set latitude, longitude and altitude\r\n");
    } else if (strcmp(token, "ad-start") == 0) {
        if (bt_advertising) {
            printk("OK: Advertising already started\r\n");
            return SUCCESS;
        }
        err = bt_advertise_start_or_update();
        if (!err) {
            printk("OK: Advertising started\r\n");
        } else {
            printk("ERROR: Failed to start advertising (code %d)\r\n", err);
        }
    } else if (strcmp(token, "ad-stop") == 0) {
        if (!bt_advertising) {
            printk("OK: Advertising already stopped\r\n");
            return SUCCESS;
        }
        err = bt_advertise_stop();
        if (!err) {
            printk("OK: Advertising stopped\r\n");
            bt_advertising = false;
        } else {
            printk("ERROR: Failed to stop advertising (code %d)\r\n", err);
        }
    } else if (strcmp(token, "pos-set") == 0) {
        // Parse latitude
        token = strtok_r(NULL, CMD_SEPARATOR, &saveptr);
        if (token == NULL) {
            printk("Missing argument: latitude\r\n");
            return ERROR_MISSING_ARGUMENTS;
        }
        long lat = coord_to_fixed_point(token);
        // Check if latitude is valid and between -90 and 90 degrees
        if (lat == ERROR_INVALID_COORDINATE || lat > 900000000 ||
            lat < -900000000) {
            printk("Invalid argument: latitude\r\n");
            return ERROR_INVALID_ARGUMENTS;
        }
        // Parse longitude
        token = strtok_r(NULL, CMD_SEPARATOR, &saveptr);
        if (token == NULL) {
            printk("Missing argument: longitude\r\n");
            return ERROR_MISSING_ARGUMENTS;
        }
        long lon = coord_to_fixed_point(token);
        if (lon == ERROR_INVALID_COORDINATE || lon > 1800000000 ||
            lon < -1800000000) {
            printk("Invalid argument: longitude\r\n");
            return ERROR_INVALID_ARGUMENTS;
        }
        // Parse altitude
        token = strtok_r(NULL, CMD_SEPARATOR, &saveptr);
        if (token == NULL) {
            printk("Missing argument: altitude\r\n");
            return ERROR_MISSING_ARGUMENTS;
        }
        int alt = atoi(token);

        bt_set_payload_data(lat, lon, alt);
        // Only update advertising if it is already started
        if (bt_advertising) {
            bt_advertise_start_or_update();
        }
        printk("OK: Set position to %ld, %ld, %d\r\n", lat, lon, alt);
    } else {
        printk("Unknown command: %s\r\n", token);
        return ERROR_UNRECOGNISED_CMD;
    }
    return err;
}

void main() {
    int err;
    // Initialize the serial (UART) device and the Bluetooth subsystem
    serial_initialise();
    err = bt_initialise();
    if (err) {
        LOG_ERR("Bluetooth init failed (err %d)\n", err);
        printk("Bluetooth init failed (err %d)\n", err);
        return;
    }

    printk("Boot complete\r\n");
    // Indefinitely wait for input from the user
    while (serial_await_message() == 0) {
        parse_cmd(serial_buffer);
    }
}
```

## src/bluetooth.c
```c
/**
 * @file bluetooth.c
 * @author Siim Lepik (siim.lepik@gmail.com)
 * @brief Bluetooth interface implementation
 * @version 0.1
 * @date 2023-02-01
 *
 * @copyright Copyright (c) 2023
 *
 */

#include "bluetooth.h"

#include <zephyr/bluetooth/bluetooth.h>
#include <zephyr/bluetooth/hci.h>
#include <zephyr/kernel.h>
#include <zephyr/logging/log.h>
#include <zephyr/types.h>

#include "utils.h"

LOG_MODULE_REGISTER(bluetooth);

#define DEVICE_NAME "GPS Beacon"
#define DEVICE_NAME_LEN (sizeof(DEVICE_NAME) - 1)

// Bluetooth advertising data and flags
struct PositionData {
    // 4 bytes for latitude, in units of 1/10000000 of a degree.
    // Positive values are north of the equator, negative values are south.
    // The range of values is, therefore, from -900000000 to 900000000.
    // This results in a worst-case precision of 11.1 mm (at the equator).
    // See: https://en.wikipedia.org/wiki/Decimal_degrees
    // This is clearly overkill for a GPS beacon, but it maximises the
    // utilisation of the 4 bytes available in the advertising packet.
    long latitude;
    // 4 bytes for longitude, in units of 1/10000000 of a degree as above.
    // Positive values are east of the prime meridian, negative values are west.
    long longitude;
    // 2 bytes for altitude, in meters. This results in a range of -32768 to
    // 32767 meters, with a precision of 1 meter.
    int altitude;
};
struct PositionData pos_data;
static bool bt_ad_initialized = false;
bool bt_advertising = false;

// Set Scan Response data (constant)
static const struct bt_data sd[] = {
    BT_DATA(BT_DATA_NAME_COMPLETE, DEVICE_NAME, DEVICE_NAME_LEN)};

// Function declarations
static void bt_ready(int err);

// Public functions

int bt_initialise() { return bt_enable(bt_ready); }

void bt_set_payload_data(long latitude, long longitude, int altitude) {
    pos_data.latitude = latitude;
    pos_data.longitude = longitude;
    pos_data.altitude = altitude;
    bt_ad_initialized = true;
}

int bt_advertise_start_or_update() {
    int err;
    char addr_s[BT_ADDR_LE_STR_LEN];
    bt_addr_le_t addr = {0};
    size_t count = 1;

    if (!bt_ad_initialized) {
        LOG_ERR("Advertising data not initialized");
        return -1;
    }

    // Create advertising data packet
    struct bt_data ad[] = {
        BT_DATA_BYTES(BT_DATA_FLAGS, BT_LE_AD_NO_BREDR),
        BT_DATA_BYTES(
            BT_DATA_MANUFACTURER_DATA, 0x0F, 0x02,  // Comodule GMBH company ID
            // Split the 4-byte latitude and longitude into 4 1-byte values
            // and put them in the advertising packet in big-endian order
            GET_BYTE(3, pos_data.latitude), GET_BYTE(2, pos_data.latitude),
            GET_BYTE(1, pos_data.latitude), GET_BYTE(0, pos_data.latitude),
            GET_BYTE(3, pos_data.longitude), GET_BYTE(2, pos_data.longitude),
            GET_BYTE(1, pos_data.longitude), GET_BYTE(0, pos_data.longitude),
            // Same for the 2-byte altitude value
            GET_BYTE(1, pos_data.altitude), GET_BYTE(0, pos_data.altitude))};

    if (!bt_advertising) {
        err = bt_le_adv_start(BT_LE_ADV_NCONN_IDENTITY, ad, ARRAY_SIZE(ad), sd,
                              ARRAY_SIZE(sd));
    } else {
        err = bt_le_adv_update_data(ad, ARRAY_SIZE(ad), sd, ARRAY_SIZE(sd));
    }

    if (err) {
        LOG_ERR("Advertising failed to %s (err %d)\r\n",
                bt_advertising ? "update" : "start", err);
        return err;
    }
    bt_advertising = true;

    // Get the device address for logging
    bt_id_get(&addr, &count);
    bt_addr_le_to_str(&addr, addr_s, sizeof(addr_s));
    LOG_INF("Beacon started, advertising as %s", addr_s);
    return 0;
}

int bt_advertise_stop() { return bt_le_adv_stop(); }

// Private functions

static void bt_ready(int err) {
    if (err) {
        LOG_ERR("Bluetooth init failed (err %d)\n", err);
        return;
    }
    LOG_INF("Bluetooth initialized");
}
```

## src/bluetooth.h
```c
/**
 * @file bluetooth.h
 * @author Siim Lepik (siim.lepik@gmail.com)
 * @brief Bluetooth interface header
 * @version 0.1
 * @date 2023-02-01
 *
 * @copyright Copyright (c) 2023
 *
 */

#ifndef GPS_BEACON_SRC_BLUETOOTH_H_
#define GPS_BEACON_SRC_BLUETOOTH_H_

#include <stdbool.h>

/**
 * @brief Flag indicating whether advertising is currently active
 */
extern bool bt_advertising;

/**
 * @brief Initialise the Bluetooth interface
 *
 * @return Error code returned by bt_enable()
 */
int bt_initialise();

/**
 * @brief Start or update Bluetooth advertising
 *
 * If advertising is already active, this function will update the advertising
 * payload with the current position data.
 *
 * If advertising is not active, this function will start advertising.
 *
 * @return Error code returned by bt_le_adv_start() or bt_le_adv_update_data()
 */
int bt_advertise_start_or_update();

/**
 * @brief Stop Bluetooth advertising
 *
 * @return Error code returned by bt_le_adv_stop()
 */
int bt_advertise_stop();

/**
 * @brief Set the payload data to be sent in the Bluetooth advertising packet
 *
 * @param latitude Latitude in degrees * 1e7. Positive values are north,
 *  negative values are south.
 * @param longitude Longitude in degrees * 1e7. Positive values are east,
 *  negative values are west.
 * @param altitude Altitude in meters
 */
void bt_set_payload_data(long latitude, long longitude, int altitude);

#endif  // GPS_BEACON_SRC_BLUETOOTH_H_
```

## src/serial.c
```c
/**
 * @file serial.c
 * @author Siim Lepik (siim.lepik@gmail.com)
 * @brief Serial interface implementation
 * @version 0.1
 * @date 2023-02-01
 *
 * @copyright Copyright (c) 2023
 *
 */

#include "serial.h"

#include <zephyr/device.h>
#include <zephyr/drivers/uart.h>
#include <zephyr/kernel.h>

#define UART_DEVICE_NODE DT_CHOSEN(zephyr_shell_uart)

// Queue to store up to 10 messages (aligned to 4-byte boundary). Needed to
// pass data from UART ISR to main thread.
K_MSGQ_DEFINE(uart_msgq, MSG_SIZE, 10, 4);

// Get UART device from device tree
static const struct device *const uart_dev = DEVICE_DT_GET(UART_DEVICE_NODE);

// Receive buffer used in UART ISR callback
static char rx_buf[MSG_SIZE];
static int rx_buf_pos;

char serial_buffer[MSG_SIZE];

// Function declarations
void serial_cb(const struct device *dev, void *user_data);

// Public functions

void serial_initialise() {
    // Configure interrupt and callback to receive serial data
    uart_irq_callback_user_data_set(uart_dev, serial_cb, NULL);
    uart_irq_rx_enable(uart_dev);
}

int serial_await_message() {
    return k_msgq_get(&uart_msgq, &serial_buffer, K_FOREVER);
}

// Private functions

/**
 * Read characters from UART until line end is detected. Afterwards push the
 * data to the message queue.
 */
void serial_cb(const struct device *dev, void *user_data) {
    uint8_t c;

    if (!uart_irq_update(uart_dev)) {
        return;
    }

    while (uart_irq_rx_ready(uart_dev)) {
        uart_fifo_read(uart_dev, &c, 1);

        if ((c == '\n' || c == '\r') && rx_buf_pos > 0) {
            // Terminate string
            rx_buf[rx_buf_pos] = '\0';

            // If queue is full, message is silently dropped
            k_msgq_put(&uart_msgq, &rx_buf, K_NO_WAIT);

            // Reset the buffer (it was copied to the msgq)
            rx_buf_pos = 0;
        } else if (rx_buf_pos < (sizeof(rx_buf) - 1)) {
            rx_buf[rx_buf_pos++] = c;
        }
    }
}
```

## src/serial.h
```c
/**
 * @file serial.h
 * @author Siim Lepik (siim.lepik@gmail.com)
 * @brief Serial interface header
 * @version 0.1
 * @date 2023-02-01
 *
 * @copyright Copyright (c) 2023
 *
 */

#ifndef GPS_BEACON_SRC_SERIAL_H_
#define GPS_BEACON_SRC_SERIAL_H_

#define MSG_SIZE 40

extern char serial_buffer[MSG_SIZE];

/**
 * @brief Initialise the serial interface
 */
void serial_initialise();

/**
 * @brief Wait for a message to be received on the serial interface
 *
 * @retval 0 Message received.
 * @retval -ENOMSG Returned without waiting.
 * @retval -EAGAIN Waiting period timed out.
 */
int serial_await_message();

#endif  // GPS_BEACON_SRC_SERIAL_H_
```

## src/utils.c
```c
#include <stdlib.h>
#include <string.h>

#include "utils.h"

long coord_to_fixed_point(char *coord) {
    char *token;
    char *saveptr;
    long fixed_point = 0;
    long fractional_part = 0;
    int i = 0;

    token = strtok_r(coord, ".", &saveptr);
    while (token != NULL) {
        if (i == 0) {
            // Parse the first part of the coordinate as degrees
            fixed_point = strtol(token, NULL, 10) * 10000000;
        } else if (i == 1) {
            // Parse the second part of the coordinate as fractional degrees
            fractional_part = strtol(token, NULL, 10);
            fractional_part *= pow_10(7 - strlen(token));
            // Correct for negative coordinates
            if (fixed_point < 0) {
                fractional_part *= -1;
            }
            fixed_point += fractional_part;
        } else {
            // There should only be two parts to the coordinate
            return ERROR_INVALID_COORDINATE;
        }
        token = strtok_r(NULL, ".", &saveptr);
        i++;
    }

    return fixed_point;
}

long pow_10(int n) {
    long result = 1;
    for (int i = 0; i < n; i++) {
        result *= 10;
    }
    return result;
}
```

## src/utils.h
```c
#ifndef GPS_BEACON_SRC_UTILS_H_
#define GPS_BEACON_SRC_UTILS_H_

// Custom error codes
/** Operation completed successfully */
#define SUCCESS 0
/** Unrecognised command */
#define ERROR_UNRECOGNISED_CMD 1
/** Missing arguments for command */
#define ERROR_MISSING_ARGUMENTS 2
/** Invalid arguments for command */
#define ERROR_INVALID_ARGUMENTS 3
/** Invalid coordinate format */
#define ERROR_INVALID_COORDINATE 0xFFFFFFFF

/** Command syntax: separator between command and arguments */
#define CMD_SEPARATOR " "

/** Extract a byte at offset n from numeric variable x */
#define GET_BYTE(n, x) ((x >> (8 * n)) & 0xFF)

/**
 * @brief Convert a coordinate string to a fixed point number
 *
 * For example, "60.1234567" will be converted to 60.1234567 * 10^7 = 601234567
 *
 * @param coord Coordinate string (e.g. "60.1234567")
 * @retval Fixed point number (e.g. 601234567) on success
 * @retval ERROR_INVALID_COORDINATE on failure
 */
long coord_to_fixed_point(char *coord);

/**
 * @brief Calculate the nth power of 10
 *
 * @param n Power
 *
 */
long pow_10(int n);

#endif  // GPS_BEACON_SRC_UTILS_H_
```
